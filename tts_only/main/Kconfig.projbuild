## tts_only/main/Kconfig.projbuild
```kconfig
menu "TTS Only Settings"

config EXAMPLE_WIFI_SSID
    string "WiFi SSID"
    default "YourSSID"
    help
        SSID for WiFi station connection.

config EXAMPLE_WIFI_PASSWORD
    string "WiFi Password"
    default "YourPassword"
    help
        Password for WiFi station connection.

config WEBSOCKET_URL
    string "WebSocket URL"
    default "wss://your.tts.server/ws"
    help
        Backend WebSocket URL for streaming ASR+LLM+TTS.

config WEBSOCKET_ACCESS_TOKEN
    string "WebSocket Access Token (Bearer)"
    default ""
    help
        Bearer token used as Authorization header for the backend.

endmenu
```

## tts_only/sdkconfig.defaults
```kconfig
# Minimal defaults for ESP-IDF v5.4 targeting ESP32-S3
CONFIG_IDF_TARGET="esp32s3"
CONFIG_ESP_CONSOLE_USB_SERIAL_JTAG=y
# If UART console is used on your board, comment the next line
CONFIG_ESP_CONSOLE_UART_DEFAULT=n
# Increase main task stack size (default 3584) to avoid overflow during opus decode
CONFIG_ESP_MAIN_TASK_STACK_SIZE=8192

# WiFi credentials (set your own)
CONFIG_EXAMPLE_WIFI_SSID="YourSSID"
CONFIG_EXAMPLE_WIFI_PASSWORD="YourPassword"

# Websocket TTS backend URL (set your own, wss/http as needed)
CONFIG_WEBSOCKET_URL="wss://your.tts.server/ws"
```
